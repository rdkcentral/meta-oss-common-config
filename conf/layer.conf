## conf/layer.conf
```bitbake
BBPATH .= ":${LAYERDIR}"

#Add recipes-* directories to BBFILES

BBFILES += "${LAYERDIR}/recipes-*/*/*.bb \
            ${LAYERDIR}/recipes-*/*/*.bbappend"

BBFILE_COLLECTIONS += "oss-common-config"
BBFILE_PATTERN_oss-common-config = "^${LAYERDIR}/"
BBFILE_PRIORITY_oss-common-config = "6"

LAYERDEPENDS_oss-common-config = "core"
LAYERSERIES_COMPAT_oss-common-config = "dunfell kirkstone scarthgap"

require include/override-pkgrev.inc

RDK_ARTIFACTS_BASE_URL ?= "file://${HOME}/ipk/"
RDK_ARTIFACTS_URL ?= "file://${HOME}/ipk/"
```
